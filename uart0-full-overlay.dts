/dts-v1/;
/plugin/;

/{
 compatible = "brcm,bcm2708";

 fragment@0 {
  target = <&uart0>;
  __overlay__ {
   pinctrl-names = "default";
   pinctrl-0 = <&uart0_pins>;
   status = "okay";
  };
 };

 fragment@1 {
  target = <&gpio>;
  __overlay__ {
   uart0_pins: uart0_pins {
    brcm,pins = <16 17 14 15>; /* UART0: CTS0 RTS0 TX0 RX0 */
    brcm,function = <7 7 4 4>; /* 7:alt3 4:alt0 */
    brcm,pull = <0 0 0 2>;
   };
  };
 };

 __overrides__ {
  cts0_pin = <&uart0_pins>,"brcm,pins:0";
  rts0_pin = <&uart0_pins>,"brcm,pins:4";
  txd0_pin = <&uart0_pins>,"brcm,pins:8";
  rxd0_pin = <&uart0_pins>,"brcm,pins:12";
  pin_func = <&uart0_pins>,"brcm,function:0",
             <&uart0_pins>,"brcm,function:4",
             <&uart0_pins>,"brcm,function:8",
             <&uart0_pins>,"brcm,function:12";
 };
};
